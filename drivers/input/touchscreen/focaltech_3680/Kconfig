## drivers/input/touchscreen/focaltech_3680/Kconfig
```kconfig
#
# Focaltech Touchscreen driver configuration
#

config TOUCHSCREEN_FOCALTECH_3680
	tristate "Focaltech Touchscreen 3680"
	help
	  Say Y here if you have Focaltech touch panel 3680.
	  If unsure, say N.

if TOUCHSCREEN_FOCALTECH_3680

config TOUCHSCREEN_FOCALTECH_TEST
	bool "Test drivers for Focaltech Touchscreen"
	help
	  Say Y here if you want to compile Focaltech test drivers.
	  If unsure, say N.

endif
```
